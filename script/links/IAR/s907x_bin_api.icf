define exported symbol __wlan_bss_end__ = 0x10015338;
define exported symbol _wlan_is_running = 0x18039e7d;
define exported symbol s907x_wlan_off = 0x180393d9;
define exported symbol _wlan_send_mgt = 0x18039f89;
define exported symbol _wlan_get_phy_mode = 0x18039fb9;
define exported symbol _wlan_get_country = 0x1803a201;
define exported symbol _wlan_add_ie = 0x1803a115;
define exported symbol system_init_config = 0x1801ebc5;
define exported symbol _wlan_set_rtos_hookfunc = 0x18039e5d;
define exported symbol _wlan_ap_del_sta = 0x1803a185;
define exported symbol _wlan_set_apnetif = 0x180385dd;
define exported symbol _wlan_start_scan = 0x18039ea9;
define exported symbol _wlan_set_stanetif = 0x180385d1;
define exported symbol s907x_wlan_on = 0x180392ad;
define exported symbol _wlan_set_phy_mode = 0x18039f95;
define exported symbol uart_dma_rx_addr = 0x1801d895;
define exported symbol _wlan_start_monitor = 0x18039f5d;
define exported symbol wifi_unreg_event_handler = 0x18039b81;
define exported symbol _wlan_get_autoreconnect = 0x1803a365;
define exported symbol _wlan_set_rx_mgnt_cb = 0x1803a3b1;
define exported symbol _wlan_rf_off = 0x18039e79;
define exported symbol _wlan_set_country = 0x1803a1ad;
define exported symbol _wlan_link_info = 0x1803a11d;
define exported symbol pmu_yield_os_check = 0x1804589d;
define exported symbol _wlan_start_ap_normal = 0x1803a291;
define exported symbol _wlan_send = 0x1801f681;
define exported symbol _wlan_enable_autoreconnect = 0x1803a34d;
define exported symbol _wlan_disable_autoreconnect = 0x1803a359;
define exported symbol _wlan_set_channel = 0x18039e9d;
define exported symbol _wlan_recv = 0x1801f6fd;
define exported symbol _wlan_start_sta = 0x1803a251;
define exported symbol _wlan_set_mac_no_efuse = 0x1803a02d;
define exported symbol _wlan_set_netfunc = 0x180385b5;
define exported symbol _wlan_reg_event = 0x1803a385;
define exported symbol __wlan_bss_start__ = 0x1000d940;
define exported symbol s907x_set_sleeptime = 0x1803a379;
define exported symbol _wlan_rf_on = 0x18039e75;
define exported symbol _wlan_get_channel = 0x18039ea5;
define exported symbol wifi_rx_beacon_hdl = 0x18038171;
define exported symbol _wlan_get_mac = 0x1803a0d5;
define exported symbol _wlan_unreg_event = 0x1803a391;
define exported symbol s907x_wlan_get_mode = 0x18039e51;
define exported symbol _wlan_set_mac = 0x18039ffd;
define exported symbol _wlan_start_ap_hidden_ssid = 0x1803a2c9;
define exported symbol _wlan_disconnect = 0x18039f21;
define exported symbol wifi_reg_event_handler = 0x18039b2d;
define exported symbol _wlan_set_mpmode = 0x1803a39d;
define exported symbol _wlan_stop_ap = 0x1803a16d;
define exported symbol _wlan_start_scan_ssid = 0x18039eb5;
define exported symbol _wlan_get_associated = 0x18039ed5;
define exported symbol _wlan_del_ie = 0x1803a119;
define exported symbol i2s_ll_get_pagesize = 0x1801e5c5;
define exported symbol sci_ll_crypto_aes_ctr_init = 0x1801f365;
define exported symbol i2s_ll_set_direction = 0x1801e56d;
define exported symbol sci_ll_crypto_aes_cbc_decrypt = 0x1801f395;
define exported symbol spi_ll_tx_allow = 0x1801e139;
define exported symbol rtc_ll_init = 0x1801ea85;
define exported symbol i2s_ll_set_it_enable = 0x1801e695;
define exported symbol spi_ll_get_datalen = 0x1801def9;
define exported symbol timer_ll_capture_dma_stop = 0x1801d4d9;
define exported symbol spi_ll_set_speed = 0x1801e101;
define exported symbol spi_ll_set_itmask = 0x1801e205;
define exported symbol timer_ll_get_count = 0x1801d125;
define exported symbol sci_ll_crypto_aes_ctr_encrypt = 0x1801f355;
define exported symbol hal_ll_dsleep_set_wakepin_event = 0x1801f0e9;
define exported symbol i2c_ll_dma_set_trx = 0x1801ddf5;
define exported symbol sci_ll_crypto_3des_cbc_init = 0x1801f33d;
define exported symbol i2c_ll_master_write = 0x1801db91;
define exported symbol hal_ll_start_osc32k = 0x1801f195;
define exported symbol uart_ll_get_flag = 0x1801d7fd;
define exported symbol spi_ll_init = 0x1801df79;
define exported symbol uart_dma_ll_rx_stop = 0x1801d8a9;
define exported symbol mem_ll_cpy = 0x1801f289;
define exported symbol uart_ll_cmd = 0x1801d5a5;
define exported symbol hal_ll_unregister_user_sleep_irq = 0x1801eca9;
define exported symbol adc_ll_cmd = 0x1801cf69;
define exported symbol pmu_ll_sleep_check_ok = 0x180455f9;
define exported symbol uart_ll_recv_byte = 0x1801d799;
define exported symbol ps_ll_enable2 = 0x1801f039;
define exported symbol gpio_ll_it_mask = 0x1801cea9;
define exported symbol uart_dma_rx_opt = 0x1801d949;
define exported symbol flash_ll_erase = 0x1801ed31;
define exported symbol delay_ll_us = 0x1801f2dd;
define exported symbol i2c_ll_dma_mode = 0x1801de8d;
define exported symbol hal_ll_register_user_sleep_irq = 0x1801ec9d;
define exported symbol hal_ll_set_download = 0x1801f249;
define exported symbol adc_ll_poll_result = 0x1801cfe5;
define exported symbol system_ll_reset = 0x1801f27d;
define exported symbol gpio_ll_set_io = 0x1801cdf5;
define exported symbol uart_ll_dma_config = 0x1801d989;
define exported symbol wdg_ll_deinit = 0x1801eced;
define exported symbol uart_ll_clr_error = 0x1801d7a9;
define exported symbol spi_ll_check_busy = 0x1801e1e5;
define exported symbol flash_ll_write = 0x1801ed75;
define exported symbol loguart_ll_init = 0x1801e9f9;
define exported symbol i2c_ll_slavor_write_it = 0x1801dc45;
define exported symbol vPort_ll_SuppressTicksAndSleep = 0x18045a25;
define exported symbol uart_ll_rx_allow = 0x1801d859;
define exported symbol rf_ll_get_version = 0x1801ec6d;
define exported symbol i2c_ll_get_status = 0x1801dc89;
define exported symbol timer_ll_init_base = 0x1801d1e9;
define exported symbol uart_ll_tx_allow = 0x1801d841;
define exported symbol sci_ll_crypto_init = 0x1801f2ed;
define exported symbol wdg_ll_init = 0x1801ecc1;
define exported symbol i2c_ll_dma_legacy = 0x1801de49;
define exported symbol timer_ll_capture_dma = 0x1801d4e5;
define exported symbol sci_ll_crypto_aes_cbc_encrypt = 0x1801f3a5;
define exported symbol i2c_ll_dma_config = 0x1801debd;
define exported symbol sci_ll_crypto_aes_ecb_init = 0x1801f38d;
define exported symbol spi_ll_get_rxfifo = 0x1801e181;
define exported symbol i2s_ll_get_isr = 0x1801e5e5;
define exported symbol adc_ll_init = 0x1801cf45;
define exported symbol adc_ll_set_analog = 0x1801cfd1;
define exported symbol spi_ll_dma_config = 0x1801e319;
define exported symbol uart_ll_set_powerlevel = 0x1801d62d;
define exported symbol i2s_ll_cmd = 0x1801e5b5;
define exported symbol user_ll_get_flash_para = 0x1801ec81;
define exported symbol wdg_ll_stop = 0x1801ed0d;
define exported symbol spi_ll_dma_set_trx = 0x1801e2c5;
define exported symbol timer_ll_init_capture = 0x1801d551;
define exported symbol timer_ll_set_period = 0x1801d159;
define exported symbol i2c_ll_slave_read = 0x1801dbf1;
define exported symbol mem_ll_set = 0x1801f291;
define exported symbol uart_ll_set_baud = 0x1801d5b9;
define exported symbol uart_ll_init = 0x1801d6cd;
define exported symbol i2s_ll_set_trx_buf = 0x1801e72d;
define exported symbol vs_ll_printf = 0x1801f299;
define exported symbol i2c_ll_dma_cmd = 0x1801decd;
define exported symbol spi_dma_rx_opt = 0x1801e225;
define exported symbol uart_ll_burst_size = 0x1801d961;
define exported symbol hal_ll_sleep_event_clear = 0x1801eee1;
define exported symbol sci_ll_crypto_3des_cbc_encrypt = 0x1801f32d;
define exported symbol mem_ll_cmp = 0x1801f281;
define exported symbol i2s_ll_init_base = 0x1801e35d;
define exported symbol gpio_ll_init = 0x1801cd0d;
define exported symbol timer_ll_set_ccr = 0x1801d189;
define exported symbol timer_ll_pwm_dma = 0x1801d395;
define exported symbol ps_ll_set_wakeupmode = 0x1801ef09;
define exported symbol i2s_ll_clear_isr = 0x1801e6b5;
define exported symbol timer_ll_pwm_cmd = 0x1801d32d;
define exported symbol timer_ll_set_polarity = 0x1801d2f5;
define exported symbol timer_ll_get_tick = 0x1801d151;
define exported symbol spi_dma_tx_opt = 0x1801e275;
define exported symbol uart_ll_set_itmask = 0x1801d7b9;
define exported symbol wl_ll_ps_enable = 0x1801f191;
define exported symbol ps_ll_disable = 0x1801ef05;
define exported symbol sci_ll_crypto_des_cbc_init = 0x1801f315;
define exported symbol sci_ll_crypto_3des_cbc_decrypt = 0x1801f31d;
define exported symbol i2s_ll_dma_config = 0x1801e681;
define exported symbol uart_dma_tx_opt = 0x1801d955;
define exported symbol timer_ll_init_pwm = 0x1801d299;
define exported symbol hal_ll_stady_wake = 0x1801ecb5;
define exported symbol gpio_ll_write = 0x1801cdc9;
define exported symbol adc_ll_set_oneshot = 0x1801d00d;
define exported symbol flash_ll_read = 0x1801c9d1;
define exported symbol uart_ll_set_rx_thd = 0x1801d5fd;
define exported symbol int_ll_unreg = 0x1801f2b5;
define exported symbol timer_ll_cmd = 0x1801d1b9;
define exported symbol adc_ll_mask_it = 0x1801cf79;
define exported symbol spi_ll_rx_allow = 0x1801e15d;
define exported symbol uart_ll_send_byte = 0x1801d78d;
define exported symbol int_ll_int_disable = 0x1801f2c9;
define exported symbol i2c_ll_deinit = 0x1801db01;
define exported symbol pinmux_ll_swd_off = 0x1801ccdd;
define exported symbol rtc_ll_alarm_clr = 0x1801eb35;
define exported symbol pinmux_ll_config = 0x1801ccc5;
define exported symbol i2c_ll_init = 0x1801d9dd;
define exported symbol freertos_ll_post_sleep_processing = 0x180459fd;
define exported symbol sci_ll_crypto_des_cbc_encrypt = 0x1801f305;
define exported symbol i2c_ll_cmd = 0x1801dae1;
define exported symbol c32k_ll_patch_en = 0x1801eba9;
define exported symbol rtc_ll_settime = 0x1801eab9;
define exported symbol pmu_ll_stady_wake = 0x180455d5;
define exported symbol adc_ll_read = 0x1801cfc9;
define exported symbol i2s_ll_init = 0x1801e381;
define exported symbol i2c_ll_slave_write = 0x1801dbd1;
define exported symbol wdg_ll_start = 0x1801ecf9;
define exported symbol freertos_ll_ready_to_sleep = 0x180458a9;
define exported symbol ps_ll_enable = 0x1801efe9;
define exported symbol rtc_ll_alarm_cmd = 0x1801eb29;
define exported symbol i2c_ll_set_itmask = 0x1801db25;
define exported symbol os_ll_init = 0x1801f29d;
define exported symbol rtc_ll_selectclk = 0x1801eab1;
define exported symbol gpio_ll_deinit = 0x1801cda1;
define exported symbol timer_ll_clear_flag = 0x1801d0c5;
define exported symbol delay_ll_ms = 0x1801f2e5;
define exported symbol pll_ll_cmd = 0x1801cef9;
define exported symbol loguart_ll_deinit = 0x1801ea79;
define exported symbol i2c_ll_master_read_it = 0x1801dc59;
define exported symbol i2s_ll_get_cur_page = 0x1801e5d5;
define exported symbol adc_ll_clr_flag = 0x1801cfc1;
define exported symbol adc_ll_get_flag = 0x1801cfad;
define exported symbol sci_ll_crypto_aes_ecb_encrypt = 0x1801f37d;
define exported symbol hal_ll_calib_osc8m = 0x1801f199;
define exported symbol uart_ll_dma_cmd = 0x1801d871;
define exported symbol spi_ll_write = 0x1801e1a1;
define exported symbol sci_ll_crypto_des_cbc_decrypt = 0x1801f2f5;
define exported symbol i2s_ll_init_trx_page = 0x1801e6f9;
define exported symbol i2s_ll_deinit = 0x1801e479;
define exported symbol i2s_ll_page_infor = 0x1801e5f9;
define exported symbol i2c_ll_set_slave_addr = 0x1801dac1;
define exported symbol i2c_ll_master_read = 0x1801dbb1;
define exported symbol rtc_ll_deinit = 0x1801eaad;
define exported symbol hal_ll_dsleep_set_timer_event = 0x1801f135;
define exported symbol freertos_ll_pre_sleep_processing = 0x180458b9;
define exported symbol sci_ll_crypto_aes_ctr_decrypt = 0x1801f345;
define exported symbol i2c_dma_tx_opt = 0x1801dd65;
define exported symbol timer_ll_pwm_dma_stop = 0x1801d4b9;
define exported symbol timer_ll_set_itmask = 0x1801d0f5;
define exported symbol i2s_ll_dma_enable = 0x1801e62d;
define exported symbol uart_dma_ll_tx_stop = 0x1801d8f9;
define exported symbol int_ll_int_enable = 0x1801f2bd;
define exported symbol rtc_ll_init_alarm = 0x1801eb3d;
define exported symbol sci_ll_crypto_aes_ecb_decrypt = 0x1801f36d;
define exported symbol i2c_ll_get_flag = 0x1801dce1;
define exported symbol wdg_ll_it_mask = 0x1801ed19;
define exported symbol gpio_ll_read = 0x1801ce81;
define exported symbol spi_ll_read = 0x1801e1c1;
define exported symbol i2c_ll_slavor_read_it = 0x1801dc71;
define exported symbol uart_ll_deinit = 0x1801d77d;
define exported symbol int_ll_reg = 0x1801f2a5;
define exported symbol i2c_dma_rx_opt = 0x1801ddb1;
define exported symbol hal_ll_mp_handle = 0x1801f1a9;
define exported symbol i2s_ll_set_param = 0x1801e4cd;
define exported symbol spi_ll_deinit = 0x1801e0e5;
define exported symbol i2c_ll_master_write_it = 0x1801dc11;
define exported symbol periph_rcc_ll_cmd = 0x1801cf3d;
define exported symbol gpio_ll_irq = 0x1801f2d5;
define exported symbol rtc_ll_gettime = 0x1801eae9;
define exported symbol gpio_ll_pull = 0x1801ce2d;
define exported symbol sci_ll_crypto_aes_cbc_init = 0x1801f3b5;
define exported symbol i2s_ll_trxpage_dmaen = 0x1801e649;
define exported symbol i2c_ll_clr_flag = 0x1801dd2d;
define exported symbol wdg_ll_refresh = 0x1801ed05;
